## sdkconfig.defaults.esp32
```kconfig
CONFIG_ESPTOOLPY_FLASHSIZE_4MB=y
CONFIG_PARTITION_TABLE_CUSTOM=y
CONFIG_PARTITION_TABLE_CUSTOM_FILENAME="partitions/v2/4m.csv"
# CONFIG_SEND_WAKE_WORD_DATA is not set
CONFIG_ESP_TASK_WDT_TIMEOUT_S=20
```
